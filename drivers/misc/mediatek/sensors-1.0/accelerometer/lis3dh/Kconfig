## drivers/misc/mediatek/sensors-1.0/accelerometer/lis3dh/Kconfig
```kconfig
config MTK_LIS3DH
	bool "MTK_LIS3DH for MediaTek package"
	default n
	help
		It support different accelerometer sensor.
		If this option is set, it will support LIS3DH Accelerometer.
```

## drivers/misc/mediatek/sensors-1.0/alsps/stk3x1x-new/Kconfig
```kconfig
config MTK_STK3X1X_NEW
	bool "stk3x1x for MediaTek package"
	default n
	help
	It support different type sensor
	in this platform. If this option
	is set, it will support ambient
	and light sensor stk3x1x.
```

## drivers/misc/mediatek/touchkey/Kconfig
```kconfig
config MTK_TOUCHKEY
	bool CONFIG_MTK_TOUCHKEY
	default n
	help
		Touchkey support

config MTK_TOUCHKEY_AW9201_SUPPORT
	bool "AW9201 Touchkey Driver"
	default n
	help
		AW9201 Touchkey (mBack)
```
